#include "pitches.h"
#include <PCM.h>

const int BUTTON_PIN_A = 13;
const int BUTTON_PIN_B = 12;

//Feedback stuff
const int LED_PIN = 11;
boolean isBothPressed = false;

const int SPEAKER_PIN = 10;
// notes in the melody:
// notes of the moledy followed by the duration.
// a 4 means a quarter note, 8 an eighteenth , 16 sixteenth, so on
// !!negative numbers are used to represent dotted notes,
// so -4 means a dotted quarter note, that is, a quarter plus an eighteenth!!
int melody[] = {
  
  // Dart Vader theme (Imperial March) - Star wars 
  // Score available at https://musescore.com/user/202909/scores/1141521
  // The tenor saxophone part was used
  
  NOTE_A4,-4, NOTE_A4,-4, NOTE_A4,16, NOTE_A4,16, NOTE_A4,16, NOTE_A4,16, NOTE_F4,8, REST,8,
  NOTE_A4,-4, NOTE_A4,-4, NOTE_A4,16, NOTE_A4,16, NOTE_A4,16, NOTE_A4,16, NOTE_F4,8, REST,8,
  NOTE_A4,4, NOTE_A4,4, NOTE_A4,4, NOTE_F4,-8, NOTE_C5,16,

  NOTE_A4,4, NOTE_F4,-8, NOTE_C5,16, NOTE_A4,2,//4
  NOTE_E5,4, NOTE_E5,4, NOTE_E5,4, NOTE_F5,-8, NOTE_C5,16,
  NOTE_A4,4, NOTE_F4,-8, NOTE_C5,16, NOTE_A4,2,
  
  NOTE_A5,4, NOTE_A4,-8, NOTE_A4,16, NOTE_A5,4, NOTE_GS5,-8, NOTE_G5,16, //7 
  NOTE_DS5,16, NOTE_D5,16, NOTE_DS5,8, REST,8, NOTE_A4,8, NOTE_DS5,4, NOTE_D5,-8, NOTE_CS5,16,

  NOTE_C5,16, NOTE_B4,16, NOTE_C5,16, REST,8, NOTE_F4,8, NOTE_GS4,4, NOTE_F4,-8, NOTE_A4,-16,//9
  NOTE_C5,4, NOTE_A4,-8, NOTE_C5,16, NOTE_E5,2,

  NOTE_A5,4, NOTE_A4,-8, NOTE_A4,16, NOTE_A5,4, NOTE_GS5,-8, NOTE_G5,16, //7 
  NOTE_DS5,16, NOTE_D5,16, NOTE_DS5,8, REST,8, NOTE_A4,8, NOTE_DS5,4, NOTE_D5,-8, NOTE_CS5,16,

  NOTE_C5,16, NOTE_B4,16, NOTE_C5,16, REST,8, NOTE_F4,8, NOTE_GS4,4, NOTE_F4,-8, NOTE_A4,-16,//9
  NOTE_A4,4, NOTE_F4,-8, NOTE_C5,16, NOTE_A4,2,
  
};
// sizeof gives the number of bytes, each int value is composed of two bytes (16 bits)
// there are two values per note (pitch and duration), so for each note there are four bytes
int notes = sizeof(melody) / sizeof(melody[0]) / 2;

// this calculates the duration of a whole note in ms
int wholenote = (60000 * 4) / 120; //tempo

int divider = 0, noteDuration = 0;

//Encoded MP3 Sequence
const unsigned char sample[] PROGMEM = {
  126, 126, 126, 126, 127, 127, 128, 128, 129, 128, 128, 128,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 75,// 92, 115, 134, 143, 138, 129, 114, 108, 104, 101, 99, 100, 102,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 131, 
};

//const int DATA = 5;
//const int LATCH = 6;
//const int CLOCK = 7;
//
//byte pattern[8] = {
//  B00000000,
//  B00000000,
//  B00111100,
//  B01000010,
//  B01111110,
//  B01000010,
//  B01000010,
//  B01000010
//};

void blinkyBoi(int pin){
  digitalWrite(pin, HIGH);
  delay(100);
  digitalWrite(pin, LOW);
  delay(100);
  digitalWrite(pin, HIGH);
  delay(100);
  digitalWrite(pin, LOW);
  delay(100);
  digitalWrite(pin, HIGH);
  delay(100);
}

//void fancyLightyBoi(int delayTime){
//  for (byte i=0; i<8; i++) {
//   digitalWrite(LATCH, LOW);
//   shiftOut(DATA, CLOCK, LSBFIRST, pattern[i]);
//   shiftOut(DATA, CLOCK, LSBFIRST, 1<<i);
//   digitalWrite(LATCH, HIGH);
//   delay(delayTime);
// }
//}

void playMelody(){
  // Remember, the array is twice the number of notes (notes + durations)
  for (int thisNote = 0; thisNote < notes * 2; thisNote = thisNote + 2) {

    // calculates the duration of each note
    divider = melody[thisNote + 1];
    if (divider > 0) {
      // regular note, just proceed
      noteDuration = (wholenote) / divider;
    } else if (divider < 0) {
      // dotted notes are represented with negative durations!!
      noteDuration = (wholenote) / abs(divider);
      noteDuration *= 1.5; // increases the duration in half for dotted notes
    }

    // we only play the note for 90% of the duration, leaving 10% as a pause
    tone(SPEAKER_PIN, melody[thisNote], noteDuration*0.9);

    // Wait for the specief duration before playing the next note.
    delay(noteDuration);
    
    // stop the waveform generation before the next note.
    noTone(SPEAKER_PIN);
  }
}

void setup() {
  // initialize serial communication at 9600 bits per second:
  Serial.begin(9600);
  
  // make the pushbutton's pin an input:
  pinMode(BUTTON_PIN_A, INPUT);
  pinMode(BUTTON_PIN_B, INPUT);

  pinMode(LED_PIN, OUTPUT);
  
//  pinMode(DATA, OUTPUT);
//  pinMode(LATCH, OUTPUT);
//  pinMode(CLOCK, OUTPUT);

//  playMelody();
  //Play encoded MP3 sequence
//  startPlayback(sample, sizeof(sample));
}

void loop() {
  // read the input pin and print out the state of the button:
  int buttonState_A = digitalRead(BUTTON_PIN_A);
  int buttonState_B = digitalRead(BUTTON_PIN_B);
  
  Serial.println(buttonState_A); // 1 is on (pushed), 0 is off
  Serial.println(buttonState_B); // 1 is on (pushed), 0 is off

  if(buttonState_A == 1 && buttonState_B == 1) {
    isBothPressed = true;
    blinkyBoi(LED_PIN);
  } else if(isBothPressed) {
    digitalWrite(LED_PIN, HIGH);
  } else {
    digitalWrite(LED_PIN, LOW);
  }
  
//  blinkyBoi(LED_PIN);
  
  delay(10); // delay in between reads for stability (1000 = 1 second).
}
